## main/Kconfig.projbuild
```kconfig
menu "Observore"

config OBSERVORE_HOSTNAME
    string "Hostname"
    default "observore"
    help
        Used twice.  It is the mDNS name, answering as "<hostname>.local" on
        the link it is joined to.  It is also the hostname offered in the DHCP
        request, which is what a router registers in its own DNS and shows in
        its client list.

        The DHCP one is the more useful of the two across subnets: mDNS is
        link-local multicast and does not route, so a device on an isolated
        VLAN needs the router to reflect mDNS before the .local name reaches
        the main LAN -- whereas ordinary DNS crosses VLANs by design.

        mDNS names are always ".local" (RFC 6762); that suffix is not taken
        from DHCP and must not be changed.

config OBSERVORE_LED_GPIO
    int "User LED GPIO"
    default 27 if IDF_TARGET_ESP32C5
    default 21
    help
        GPIO21 is the XIAO ESP32S3 user LED.  GPIO27 is the addressable RGB LED
        on the ESP32-C5-DevKitC-1 and on Waveshare's ESP32-C5-WIFI6-KIT, which
        share a pinout.

choice OBSERVORE_LED_KIND
    prompt "User LED type"
    default OBSERVORE_LED_ADDRESSABLE if IDF_TARGET_ESP32C5
    default OBSERVORE_LED_MONO
    help
        Which kind of LED is on OBSERVORE_LED_GPIO.  Driving an addressable
        pixel as a plain GPIO leaves it dark or stuck on a random colour, and
        driving a plain LED as a pixel does nothing at all, so this has to
        match the board.

config OBSERVORE_LED_MONO
    bool "Single-colour LED on a GPIO"
    help
        One monochrome LED driven directly.  Threat level is a blink rhythm,
        because there is no colour to carry it.

config OBSERVORE_LED_ADDRESSABLE
    bool "Addressable RGB pixel (WS2812)"
    help
        A WS2812 or compatible pixel on a single data line.  Threat level is a
        colour, which is legible at a glance in a way that counting flashes
        never is.

config OBSERVORE_LED_NONE
    bool "No user LED"
    help
        The board has no LED to drive.  Choose this rather than pointing
        OBSERVORE_LED_GPIO at a pin that is probably free: on a dense board
        an unused number usually belongs to something, and driving it is how
        you find out what.  A board with a panel says everything the LED
        would have said, so nothing is lost but the blink.

endchoice

config OBSERVORE_LED_ACTIVE_LOW
    bool "The LED is active low"
    depends on OBSERVORE_LED_MONO
    default y
    help
        True when the pin sinks the LED, so driving it low lights it -- which
        is how the XIAO ESP32S3 is wired.  Boards that source the LED from the
        pin want this off, otherwise the LED is lit whenever it should be dark.

config OBSERVORE_LED_BRIGHTNESS
    int "Addressable LED brightness (1-255)"
    depends on OBSERVORE_LED_ADDRESSABLE
    range 1 255
    default 24
    help
        WS2812 pixels are painfully bright at full scale, and this device is
        meant to sit in a room unattended.  The default is dim enough to live
        with overnight and still be obvious in daylight.

config OBSERVORE_BUTTON_GPIO
    int "Mode button GPIO"
    default 28 if IDF_TARGET_ESP32C5
    default 0
    help
        The BOOT button, active low: GPIO0 on the XIAO ESP32S3, GPIO28 on the
        ESP32-C5.  Holding it while running toggles the console SoftAP; it only
        enters download mode when held across a reset, so reusing it here is
        safe.

config OBSERVORE_NTP_SERVER
    string "Fallback NTP server"
    default "pool.ntp.org"
    help
        Used only when the network hands out no NTP server over DHCP.

        DHCP is tried first on purpose. This device is meant to sit on the
        segment the cameras are on, and that segment is often firewalled from
        the internet -- the same isolation that stops a push notification
        reaching its server stops a public pool answering. A router's own NTP
        is reachable from inside that fence.

        Times are always UTC on the wire; the console renders local.

comment "Wi-Fi uplink -- leave blank here and set it with menuconfig or NVS"

config OBSERVORE_WIFI_SSID
    string "Home network SSID (optional)"
    default ""
    help
        Leave this EMPTY in sdkconfig.defaults, which is a tracked file.  Set
        it with `idf.py menuconfig` (it lands in sdkconfig, which is
        gitignored), or with a gitignored credentials.conf, or at runtime from
        the console -- which stores it in NVS and never touches the repo at
        all.  A credential set at runtime takes precedence over this one.

        tools/check_no_secrets.sh fails if a value ends up in a tracked file.

config OBSERVORE_WIFI_PASSWORD
    string "Home network password (optional)"
    default ""
    help
        Empty means an open network.  Same warning as the SSID above: never
        commit a real value.

config OBSERVORE_WIFI_AUTOJOIN
    bool "Join the configured network at boot"
    default y
    help
        When credentials are configured, join at boot so the console is
        reachable on your LAN without the SoftAP.

        This costs detection: the radio has one channel, so while associated
        the Wi-Fi sniffer is suspended and only BLE scanning and AP scans
        continue.  Turn this off to stay on full patrol and reach the uplink
        only on demand.  If the network cannot be joined, Observore falls back to
        patrol rather than sitting associated to nothing.

config OBSERVORE_PATROL_WINDOW_S
    int "Seconds spent patrolling before visiting the uplink"
    default 120
    range 20 3600
    help
        Observore is built to sit in one place, and all Wi-Fi detection -- the
        access-point scan and the promiscuous sniff both -- runs only while
        patrolling.  A device parked permanently on the uplink is a BLE-only
        detector, which gives up Remote ID drone and hidden-AP detection
        entirely.  So it alternates: patrol for this long, then join the
        network briefly to push what it found.

config OBSERVORE_MESH_TX
    bool "Warn other Observore nodes over BLE (spends the device's passivity)"
    default n
    select BT_NIMBLE_ROLE_BROADCASTER
    help
        Transmit what this node has found, as a BLE advert other Observore
        nodes can hear (#132). Off by default, and off is the important case.

        What it costs is the property that makes this device defensible.
        Everything else it does is receive-only: the BLE scan emits no
        SCAN_REQ, the Wi-Fi scan sends no probe requests, the sniffer only
        listens. Nothing can locate it by listening. A node that warns can be
        found by direction-finding, and "there is an observer here" is the one
        thing a counter-surveillance device should not announce.

        There is an irony to pay for as well: this project classifies
        SquachWatch as a `peer-detector` precisely because it announces itself
        in mesh mode. A warning Observore becomes a peer-detector in somebody
        else's device, including another Observore.

        Note what this option does rather than merely setting a flag. With it
        unset, BT_NIMBLE_ROLE_BROADCASTER is unset too, so the code that
        advertises is not compiled at all -- the build cannot transmit, and
        there is no runtime path to make it. That is worth more than a boolean
        somebody could flip by accident, and it is the same way the console
        keeps automatic suppression out of the monitors: by not having the
        caller.

        A node with nothing to warn about stays silent. It transmits when it
        has a finding worth passing on and not otherwise, so an idle node is
        exactly as quiet as one built without this.

config OBSERVORE_MAX_DEVICES
    int "Devices tracked at once"
    default 192
    range 32 512
    help
        How many devices the tracker holds simultaneously. The table lives in
        internal RAM and is walked linearly on every sighting, so it is also
        the largest single static allocation this firmware makes: at 136 bytes
        a slot, 192 slots is 26 KB.

        Per board rather than global, because the boards differ by more than
        taste. Measured with the heap caps corrected (see
        observore_heapwatch.h), the 3.5" Cheap Yellow Display was running at a
        low-water mark of 820 bytes: a 480x320 panel with no PSRAM to put a
        framebuffer in, Wi-Fi and BLE both up, and 98 KB of static DRAM in
        this firmware's own symbols. That board took an unexplained
        SW_CPU_RESET on the bench and could not serve its own status page,
        which is how the margin came to be measured at all.

        The cost of a smaller table is a shorter window of what is nearby, not
        a loss of memory: the table evicts the device heard from longest ago,
        so in a crowded place it holds less history of the room. Mute rules,
        the household census and the detection history are all separate and
        are untouched.

        Keep this at 32 or more. Nothing enforces a relationship with
        OBSERVORE_HISTORY_MAX, but a table smaller than what the console shows
        in one page makes the two views disagree for no gain.

menu "Display"

# Peripherals that are not the panel.
#
# These lived inside "if OBSERVORE_DISPLAY" once, which cost every headless
# board a build: CONFIG_OBSERVORE_TZ is read as a value rather than tested,
# so on a board with no screen it was not merely false, it did not exist, and
# the clock failed to compile. Nothing here depends on there being a display
# -- a headless sensor can have a clock chip, a cell and an accelerometer as
# easily as a round one can.

config OBSERVORE_I2C
    bool "Shared I2C bus"
    default n
    help
        One bus, several chips.  Selected by whatever needs it rather than
        set by hand: the touch controller and the motion sensor on the round
        board share two wires, and the driver refuses a second bus on the
        same port.

config OBSERVORE_I2C_SDA
    int "I2C SDA GPIO"
    depends on OBSERVORE_I2C
    default 47

config OBSERVORE_I2C_SCL
    int "I2C SCL GPIO"
    depends on OBSERVORE_I2C
    default 48

config OBSERVORE_WATCHFACE
    bool "A watch face page"
    depends on OBSERVORE_DISPLAY_QSPI_AMOLED
    default n
    help
        An analogue dial with hands, on the round panel.  It is a disguise as
        much as a clock: a device carried in a pocket and glanced at is far
        less conspicuous showing the time than showing a list of everybody's
        Bluetooth addresses.

        The threat level still reaches the wearer, as the colour of the hour
        markers -- legible to somebody who knows what they mean and nothing at
        all to somebody glancing over a shoulder.

        Needs a frame buffer, which is why it is limited to the board with
        eight megabytes of PSRAM: a dial has diagonals in it, and the text
        grid the other boards draw with cannot.

config OBSERVORE_RTC
    bool "Real-time clock (PCF85063)"
    default n
    select OBSERVORE_I2C
    help
        A clock that keeps time across a reboot without a network.  Without
        one, the time comes only from SNTP -- which means only from home, so a
        device restarted somewhere else has no idea what time it is and the
        findings it records are undated.

config OBSERVORE_RTC_I2C_ADDR
    hex "Clock I2C address"
    depends on OBSERVORE_RTC
    default 0x51

config OBSERVORE_TZ
    string "Timezone, as a POSIX TZ string"
    default "UTC0"
    help
        Applied when a person reads a time, never when one is written down:
        logs, history and the clock chip all keep UTC, because a stored
        timestamp that depends on where the reader was is a timestamp nobody
        can compare.  "EST5EDT,M3.2.0,M11.1.0" for US Eastern,
        "GMT0BST,M3.5.0/1,M10.5.0" for the UK.

config OBSERVORE_BATTERY
    bool "Battery voltage sense"
    default n
    help
        Where the cell is divided into an ADC pin.  None of the Cheap Yellow
        Displays have this -- their battery connector charges a cell and
        reports nothing, which is why "dim on battery, bright on USB" was
        never possible there.

config OBSERVORE_BATTERY_ADC_CHANNEL
    int "ADC1 channel the divided cell arrives on"
    depends on OBSERVORE_BATTERY
    default 3
    help
        3 on the Waveshare AMOLED board, which is GPIO4 on an S3.  Taken from
        the vendor's own example: their wiki says GPIO5, and it has also been
        wrong about this board's touch pins and its panel power.

config OBSERVORE_MOTION
    bool "Motion sensor (QMI8658)"
    default n
    select OBSERVORE_I2C
    help
        An accelerometer, used for one thing: telling being carried from
        sitting still.  It is what makes the `tailing` class possible --
        something that stays with you across a journey is following you,
        where something that persists while the board sits on a desk is the
        neighbourhood.  Without it, nothing is ever promoted to that class
        and everything else behaves exactly as before.

config OBSERVORE_MOTION_I2C_ADDR
    hex "Motion sensor I2C address"
    depends on OBSERVORE_MOTION
    default 0x6B
    help
        0x6B on the board this was written for.  The part also answers at
        0x6A depending on how its address pin is strapped, and asking the
        wrong one produces a nack that looks exactly like a broken bus --
        which cost an afternoon here.  The startup scan prints what actually
        answered.

config OBSERVORE_DISPLAY
    bool "Panel over SPI"
    default n
    help
        A 240x320 panel driven through esp_lcd, used in landscape. Off on
        every board that has no panel. Which controller sits behind the glass
        is a separate choice, because the same product ships with more than
        one and a build for one shows garbage on the other.

if OBSERVORE_DISPLAY

choice OBSERVORE_DISPLAY_PANEL
    prompt "Panel controller"
    default OBSERVORE_DISPLAY_ST7789

config OBSERVORE_DISPLAY_ST7789
    bool "ST7789"
    help
        The later revisions of the 2.8" ESP32-2432S028R. Verified on the
        bench.

config OBSERVORE_DISPLAY_ST7796
    bool "ST7796"
    help
        The 3.5" ESP32-3248S035 boards, 480x320 in landscape. Driven through
        the espressif/esp_lcd_st7796 component.

config OBSERVORE_DISPLAY_ILI9341
    bool "ILI9341"
    help
        The original 2.8" ESP32-2432S028R and most 2.4" and 3.2" siblings.
        Driven through the espressif/esp_lcd_ili9341 component. Not yet
        confirmed on a bench: the colour order, inversion and mirroring below
        are the values every other project uses for it, and each is a build
        option in case they are wrong.

config OBSERVORE_DISPLAY_QSPI_AMOLED
    bool "SH8601 / CO5300 AMOLED over QSPI"
    help
        The round AMOLED panels on Waveshare's ESP32-S3 boards, driven over
        four data lines through espressif/esp_lcd_sh8601, which handles both
        controllers.  There is no backlight pin: brightness is a command to
        the panel, and black pixels are simply off.

        Which of the two controllers is behind the glass varies within one
        product, so it is a separate option below and getting it wrong is
        visible -- see OBSERVORE_DISPLAY_CO5300.

endchoice

config OBSERVORE_DISPLAY_PANEL_DETECT
    bool "Ask the panel which controller it is"
    depends on OBSERVORE_DISPLAY_QSPI_AMOLED
    default y
    help
        Waveshare ships one product with either controller behind the glass,
        and they need different initialisation: a CO5300 also starts six
        pixels further along.  The wrong choice shows nothing at all, or an
        image shifted sideways.

        With this on, the panel is asked before the driver takes its pins --
        register 0xDA over a bit-banged one-line SPI, which answers 0x86 for
        an SH8601 and 0xFF for a CO5300.  One image then serves both, which
        is what a download has to do: a stranger cannot be expected to know
        which revision arrived in the post, and a blank screen tells them
        nothing.

config OBSERVORE_DISPLAY_CO5300
    bool "Assume a CO5300 rather than an SH8601"
    depends on OBSERVORE_DISPLAY_QSPI_AMOLED
    default y
    help
        Which controller to use when detection is off, or when the read
        gives an answer that names neither.  Ours answered 0xFF, a CO5300.


config OBSERVORE_DISPLAY_WIDTH
    int "Panel width in landscape, pixels"
    default 320
    help
        320 for the 2.8" boards, 480 for the 3.5" ones. The text grid is
        derived from this and the font: eight pixels per column, sixteen per
        row.

config OBSERVORE_DISPLAY_HEIGHT
    int "Panel height in landscape, pixels"
    default 240

config OBSERVORE_DISPLAY_QSPI_D0
    int "QSPI data line 0"
    depends on OBSERVORE_DISPLAY_QSPI_AMOLED
    default 11

config OBSERVORE_DISPLAY_QSPI_D1
    int "QSPI data line 1"
    depends on OBSERVORE_DISPLAY_QSPI_AMOLED
    default 12

config OBSERVORE_DISPLAY_QSPI_D2
    int "QSPI data line 2"
    depends on OBSERVORE_DISPLAY_QSPI_AMOLED
    default 13

config OBSERVORE_DISPLAY_QSPI_D3
    int "QSPI data line 3"
    depends on OBSERVORE_DISPLAY_QSPI_AMOLED
    default 14

config OBSERVORE_DISPLAY_X_OFFSET
    int "First column of the panel's own frame"
    default 0
    help
        Some controllers address a frame wider than the glass and start it
        part way along.  Six on a CO5300.  Everything drawn is shifted by
        this, and a wrong value shows as an image offset sideways with a
        stripe of stale pixels at one edge.

config OBSERVORE_DISPLAY_INSET_X
    int "Left and right margin, pixels"
    default 0
    help
        Space the text grid may not use.  Zero on a rectangular panel.  On a
        round one it is what keeps the corners of the grid inside the glass:
        the largest square that fits in a circle of diameter D has a side of
        D / sqrt(2), so a 466-pixel circle leaves 69 pixels at each side.

config OBSERVORE_DISPLAY_INSET_Y
    int "Top and bottom margin, pixels"
    default 0
    help
        As OBSERVORE_DISPLAY_INSET_X, for the other axis.

config OBSERVORE_DISPLAY_MOSI
    int "MOSI GPIO"
    default 13
config OBSERVORE_DISPLAY_MISO
    int "MISO GPIO (-1 if unused)"
    default 12
config OBSERVORE_DISPLAY_SCLK
    int "SCLK GPIO"
    default 14
config OBSERVORE_DISPLAY_CS
    int "CS GPIO"
    default 15
config OBSERVORE_DISPLAY_DC
    int "DC GPIO"
    default 2
config OBSERVORE_DISPLAY_RST
    int "Reset GPIO (-1 if wired to EN)"
    default -1
config OBSERVORE_DISPLAY_BL
    int "Backlight GPIO (-1 if always on)"
    default 21
config OBSERVORE_DISPLAY_LDR_GPIO
    int "Ambient light sensor GPIO (-1 if none)"
    default -1
    help
        The Cheap Yellow Displays carry a photoresistor, which lets the screen
        dim itself in the dark -- the state this device most wants to be in,
        since a bright panel in a dark room announces it. Must be an ADC1 pin.
        Measured rather than assumed: probe the free pins and watch which one
        moves when a hand covers the board.

config OBSERVORE_DISPLAY_LDR_DARK_IS_HIGH
    bool "The light sensor reads higher in the dark"
    default y
    depends on OBSERVORE_DISPLAY_LDR_GPIO >= 0
    help
        Which way the divider is wired. Measured on the 3.5" board: covering
        it took the reading from about 1,100 to 1,700, so darker is higher
        there. Wrong means the screen brightens in the dark, which is
        unmistakable.

config OBSERVORE_DISPLAY_MHZ
    int "SPI clock, MHz"
    default 26
    range 1 80
config OBSERVORE_DISPLAY_INVERT
    bool "Invert colours"
    default n
    help
        Wrong looks like a photographic negative and is obvious at a glance.
        The ST7789 revision of the 2432S028R on the bench did not need it,
        despite reports that it does; the ILI9341 revision is not expected to
        either.
config OBSERVORE_DISPLAY_SWAP_BYTES
    bool "Swap the two bytes of each pixel"
    default y
    help
        Each 16-bit pixel reaches the panel most significant byte first, and
        the SPI path sends the host's bytes as they are, so the swap is done
        in software.  Measured on a bench rather than taken from a datasheet:
        without it on the Cheap Yellow Displays the green band came out red.

        A panel that wants the other order shows colours that are wrong in a
        particular way -- amber turns blue, red turns cyan -- while white and
        black look perfectly correct, because those are symmetric and a swap
        does nothing to them.

config OBSERVORE_DISPLAY_BGR
    bool "Panel takes BGR order"
    default n
    help
        Wrong swaps red and blue: the alert band comes out blue.
config OBSERVORE_DISPLAY_MIRROR_X
    bool "Mirror X"
    default y
config OBSERVORE_DISPLAY_MIRROR_Y
    bool "Mirror Y"
    default n

config OBSERVORE_TOUCH
    bool "Touch panel"
    default n
    help
        Off by default: a panel without touch would only poll a line that
        never answers. Which controller is behind the glass is a separate
        choice, because the two supported ones share no wiring, no bus and
        no arithmetic.

if OBSERVORE_TOUCH

choice OBSERVORE_TOUCH_KIND
    prompt "Touch controller"
    default OBSERVORE_TOUCH_XPT2046

config OBSERVORE_TOUCH_XPT2046
    bool "XPT2046, resistive, over SPI"
    help
        The controller carried by the Cheap Yellow Displays. Resistive, so a
        press is a measured pressure and the panel needs calibrating against
        the four edges of the glass in front of you.

config OBSERVORE_TOUCH_FT3168
    bool "FT3168, capacitive, over I2C"
    select OBSERVORE_I2C
    help
        The controller on Waveshare's round AMOLED boards. Capacitive, which
        removes most of what the resistive path has to do: the chip reports
        how many fingers are down and where each one is, already in panel
        pixels, so there is no pressure threshold, no median filtering and
        no calibration to get wrong.

endchoice

config OBSERVORE_TOUCH_SDA
    int "Touch I2C SDA GPIO"
    depends on OBSERVORE_TOUCH_FT3168
    default 47

config OBSERVORE_TOUCH_SCL
    int "Touch I2C SCL GPIO"
    depends on OBSERVORE_TOUCH_FT3168
    default 48

config OBSERVORE_TOUCH_I2C_ADDR
    hex "Touch I2C address"
    depends on OBSERVORE_TOUCH_FT3168
    default 0x38

config OBSERVORE_TOUCH_SHARED_BUS
    bool "Touch is on the panel's SPI bus"
    depends on OBSERVORE_TOUCH_XPT2046
    default n
    help
        The 2.8" boards wire the touch controller to its own pins; some of the
        3.5" ones put it on the same bus as the panel with a separate chip
        select. With this set the pins below are ignored and the controller is
        added as a second device on the panel's bus, which also serialises the
        two so a measurement cannot land inside a screen update.

config OBSERVORE_TOUCH_MOSI
    int "Touch MOSI GPIO"
    depends on OBSERVORE_TOUCH_XPT2046
    default 32
config OBSERVORE_TOUCH_MISO
    int "Touch MISO GPIO"
    depends on OBSERVORE_TOUCH_XPT2046
    default 39
config OBSERVORE_TOUCH_SCLK
    int "Touch SCLK GPIO"
    depends on OBSERVORE_TOUCH_XPT2046
    default 25
config OBSERVORE_TOUCH_CS
    int "Touch CS GPIO"
    depends on OBSERVORE_TOUCH_XPT2046
    default 33
config OBSERVORE_TOUCH_POLLED
    bool "The touch controller has no interrupt line"
    depends on OBSERVORE_TOUCH_XPT2046
    default n
    help
        Some boards do not route the controller's PENIRQ anywhere.  Without
        it there is nothing to gate reads on, so the pressure channels are
        read on every poll and the threshold decides -- which is what they
        were always for.  The cost is constant traffic on a bus the panel
        shares, so the poll is slower when nothing is touching.

config OBSERVORE_TOUCH_IRQ
    int "Touch PENIRQ GPIO"
    depends on OBSERVORE_TOUCH_XPT2046
    default 36

config OBSERVORE_TOUCH_Z_MIN
    int "Pressure below which a touch is ignored"
    depends on OBSERVORE_TOUCH_XPT2046
    default 400
    range 50 4095
    help
        Measured from both Z channels, so it is much flatter across the sheet
        than Z1 alone -- but sheets still differ. Too high discards real
        presses, and the symptom is a panel that reports nothing in one part of
        the screen; too low lets electrical noise from the radio alongside it
        look like a finger.

config OBSERVORE_TOUCH_RAW_MIN_X
    int "Raw X at the low edge"
    depends on OBSERVORE_TOUCH_XPT2046
    default 200
config OBSERVORE_TOUCH_RAW_MAX_X
    int "Raw X at the high edge"
    depends on OBSERVORE_TOUCH_XPT2046
    default 3900
config OBSERVORE_TOUCH_RAW_MIN_Y
    int "Raw Y at the low edge"
    depends on OBSERVORE_TOUCH_XPT2046
    default 200
config OBSERVORE_TOUCH_RAW_MAX_Y
    int "Raw Y at the high edge"
    depends on OBSERVORE_TOUCH_XPT2046
    default 3900
    help
        The four bounds are a property of one piece of glass, not of the
        product: boards off the same reel differ by tens of counts. Build with
        OBSERVORE_TOUCH_LOG_RAW, touch each corner, and read them off the log.

config OBSERVORE_TOUCH_SWAP_XY
    bool "Touch axes are crossed relative to the display"
    depends on OBSERVORE_TOUCH_XPT2046
    default n
    help
        Wrong sends the finger along the wrong edge: dragging across the
        screen moves the mark up and down.

config OBSERVORE_TOUCH_FLIP_X
    bool "Flip touch X"
    depends on OBSERVORE_TOUCH_XPT2046
    default n
config OBSERVORE_TOUCH_FLIP_Y
    bool "Flip touch Y"
    depends on OBSERVORE_TOUCH_XPT2046
    default n
    help
        Wrong flips are unmistakable: the cursor goes the other way from the
        finger, in one axis or both.

config OBSERVORE_TOUCH_LOG_RAW
    bool "Log raw touch values"
    default n
    help
        Prints every accepted reading to the console. For calibration only --
        it is one line per poll while a finger is down.

endif

endif

endmenu

config OBSERVORE_NOTIFIER
    bool "Push notifications"
    default y
    help
        Whether the image can send notifications at all. Off means absent,
        not disabled: the notifier and its queue are not compiled in, and the
        console hides the panel rather than showing a form that cannot work.

        For a device with a display, or one only ever read through the
        console. Every memory problem this project has had was on the uplink
        and most of it was the TLS handshake behind a notification, so a board
        with little RAM and no PSRAM is better off without the code than with
        it switched off. The update check and OTA keep their own TLS path.

config OBSERVORE_BOARD
    string "Board identifier"
    default ""
    help
        Which board this image was built for, using the same names the release
        and the web flasher use: xiao-esp32s3, devkit-esp32c5, xiao-esp32c5,
        xiao-esp32c6, the three CYD profiles and waveshare-s3-amoled-143.

        This is not the chip. Two of those boards are ESP32-C5s and they are not
        interchangeable -- they differ in LED type and pin, button pin, and
        whether the USB socket is the chip's own peripheral or a UART bridge.
        A browser flashing over USB cannot tell them apart either, which is why
        the installer offers a board picker rather than deciding for you.

        A device updating itself has the same problem and no one to ask, so it
        carries the answer. Left empty, the device will not install an update:
        not knowing which image is yours is a reason to stop, not to guess.

config OBSERVORE_UPDATE_URL
    string "Update manifest URL"
    default "https://observore.forgedinfeatherstechnology.com/firmware/boards.json"
    help
        The document the device reads to learn what the current release is.
        This is the same file the web flasher uses, so a release that is
        installable is by definition one the device can see, and there is no
        second piece of infrastructure to keep in step.

        Point it somewhere else to track your own builds. It is read over
        HTTPS and verified against the certificate bundle, like the notifiers.

config OBSERVORE_UPDATE_ASSET_BASE
    string "Release asset base URL"
    default "https://github.com/Forged-in-Feathers-Technology/observore/releases/download"
    help
        Where the image itself is fetched from. The version comes from
        OBSERVORE_UPDATE_URL; this is joined with it and the board name as
        "<base>/<version>/observore-<board>.bin".

        Deliberately not the same host as the manifest. The flasher site sits
        behind a CDN that compresses this file and then answers range requests
        against the compressed copy while serving the decompressed one: asking
        for bytes 0-4095 returns 10,602 bytes and the reported total is the
        compressed size. An image assembled from those ranges is wrong.

        The release asset host answers ranges correctly, and ranges are what
        make the download affordable -- MBEDTLS_SSL_IN_CONTENT_LEN is 8192 here,
        half the largest TLS record, so an unbounded stream fails on the first
        full-size record with MBEDTLS_ERR_SSL_BAD_INPUT_DATA.

config OBSERVORE_UPDATE_CHECK_HOURS
    int "Hours between update checks"
    default 24
    range 1 168
    help
        Checking costs a TLS handshake in an uplink window, which is the most
        memory-constrained moment this device has. Once a day is plenty for
        a project that releases every few weeks, and it keeps that cost away
        from the windows where notifications need the heap.

        Set to 0 hours is not offered: use the console if you want to check
        immediately.

config OBSERVORE_UPLINK_WINDOW_S
    int "Seconds spent on the uplink before returning to patrol"
    default 30
    range 10 3600
    help
        Long enough to flush queued notifications.  The window is held open
        while somebody is actually reading the console, so browsing is never
        cut off mid-page.

config OBSERVORE_UPLINK_MAX_S
    int "Hard ceiling on one uplink visit (seconds)"
    default 180
    range 30 3600
    help
        The uplink window is extended while the console is being read, and the
        page polls every two seconds -- so a browser tab left open would keep
        the device on the uplink indefinitely, where it does no Wi-Fi detection
        at all.  Past this, it returns to patrol regardless.  A user interface
        must not be able to blind the detector.

config OBSERVORE_CONSOLE_IDLE_S
    int "Seconds of console silence before the uplink window may close"
    default 45
    range 5 600

config OBSERVORE_UPLINK_RETRY_S
    int "Backoff after a failed uplink join (seconds)"
    default 300
    range 30 3600
    help
        A join that fails costs the connect timeout, so after a failure the
        next attempt waits this long rather than retrying every patrol window
        and spending a fifteen-second stall each time.  A successful join
        resumes the ordinary alternation.

config OBSERVORE_UPLINK_GRACE_S
    int "Seconds to tolerate a dropped uplink before patrolling"
    default 45
    range 5 600
    help
        Brief drops are normal and reconnect on their own.  Past this, staying
        in uplink mode means the Wi-Fi sniffer is off and there is no network
        either, so patrolling is strictly better.

config OBSERVORE_WIFI_CONNECT_TIMEOUT_S
    int "Uplink connect timeout (seconds)"
    default 15
    range 5 60

config OBSERVORE_BLE_SCAN_INTERVAL_MS
    int "BLE scan interval (ms)"
    default 160
    range 20 1000

config OBSERVORE_BLE_SCAN_WINDOW_MS
    int "BLE scan window (ms)"
    default 60
    range 10 1000
    help
        Must not exceed the interval.  BLE and Wi-Fi share one radio and the
        coexistence arbiter divides it by this duty cycle, sharply and
        non-linearly: at a 100% duty cycle the Wi-Fi sniffer receives almost
        nothing at all (2 frames in 40 s, measured), while 37.5% still yields
        around 200.  The default trades roughly a third of BLE throughput for
        a sniffer that functions.

config OBSERVORE_CONSOLE_AUTH
    bool "Require the console password in uplink mode"
    default y
    help
        Without this, anyone who can reach the device on your network can read
        the detection log -- which says what was watching you and when -- and
        change the network it joins.

        The credential is the same generated console password printed on the
        serial log.  It is asked for once and exchanged for a session cookie,
        so the password itself is not repeated on every request; that matters
        because it is also the SoftAP's WPA2 key.

        The SoftAP is not challenged: WPA2 already authenticates that link with
        the same password, and first-time setup is the one moment the console
        is the only way in.

        Turn this off only on a network you would be content to leave the
        detection log readable on.

config OBSERVORE_AP_SSID_PREFIX
    string "Console SoftAP SSID prefix"
    default "console"
    help
        The last three bytes of the MAC are appended.  The default deliberately
        does not advertise what the device is.

config OBSERVORE_AP_PASSWORD
    string "Console SoftAP password override (leave EMPTY)"
    default ""
    help
        Leave this empty.  Each device then generates its own random console
        password on first boot, keeps it in NVS and prints it on the serial
        log -- so no two devices share one, and nothing published in this
        repository reveals it.

        Deriving the password from the MAC would be no better than publishing
        it: the SoftAP's BSSID appears in every Wi-Fi scan.

        Setting a value here overrides that, and every device built from the
        resulting firmware will share the password you choose.  It must be at
        least 8 characters or the console SoftAP falls back to open.

endmenu
```
